
//////////////////////////////////////////LIBRARIES/////////////////////////////////////////////////////////////////////////////////////////////////////////////////////////////////////////////////////////////////////////
///////////////////////////////////////////////////////////////////////////////////////////////////////////////////////////////////////////////////////////////////////////////////////////////////////////////////////////

#include <RunningAverage.h>
#include <DFRobot_BME680_I2C.h>
#include <Wire.h>
#include "esp_attr.h"
#include <Adafruit_Sensor.h>
#include <Adafruit_LSM303_U.h>
#include <Adafruit_LIS2MDL.h>
#include <AS5600.h>


////libraries stuff
Adafruit_LIS2MDL mag = Adafruit_LIS2MDL(12345);
Adafruit_LSM303_Accel_Unified accel = Adafruit_LSM303_Accel_Unified(54321);

/////////////////////////STEERING ANGLE///////////////////////////////////////////////////

AS5600 as5600; 

////////////////////////////////////////Libraries initialization////////////////////////////////////////////////////////////////////////////////////////////////////////////////////////////////////////////////////////////
////////////////////////////////////////////////////////////////////////////////////////////////////////////////////////////////////////////////////////////////////////////////////////////////////////////////////////////

RunningAverage RPM_L_RA(60);
RunningAverage RPM_R_RA(60);
RunningAverage RPM_C_RA(60);
RunningAverage RPM_CRANK_RA(60);
RunningAverage RPM_SHAFT_RA(60);

//////////////////////////////////////////////I2C sensors///////////////////////////////////////////////////////////////////////////////////////////////////////////////////////////////////////////////////////////
////////////////////////////////////////////////////////////////////////////////////////////////////////////////////////////////////////////////////////////////////////////////////////////////////////////////////

DFRobot_BME680_I2C bme(0x77);  //I2C BME680 ID

/////////////////////////////////////////////////VARIABLES///////////////////////////////////////////////////////////////////////////////////////////////////////////////////////////////////////////////////////////

///////////////////////////////////////////////////SPEED/////////////////////////////////////////////////////////////////////////////////////////////////////////////////////////////////////////////////////////////
////////////////////////////////////////////////////////////////////////////////////////////////////////////////////////////////////////////////////////////////////////////////////////////////////////////////////

unsigned long time_l;            // Calculates the time between each sector of the wheel. Time of the magnets in the left wheel
unsigned long time_r;            // Calculates the time between each sector of the wheel. Time of the magnets in the right wheel 
unsigned long time_c;            // Calculates the time between each sector of the wheel. Time of the magnets in the centre wheel 
unsigned long time_cr;           // Calculates the time between each sector of the wheel. Time of the magnets in the crank wheel 
unsigned long time_shaft;            // Calculates the time between each sector of the wheel. Time of the magnets in the centre wheel 
unsigned long time_output;
unsigned long prev_l;            //prev_ls the time of the first previous time the magnet was passed through. Time of the magnets in the left wheel 
unsigned long prev_r;           // prev_ls the time of the first previous time the magnet was passed through. Time of the magnets in the right wheel
unsigned long prev_c;          // prev_ls the time of the first previous time the magnet was passed through. Time of the magnets in the centre wheel
unsigned long prev_cr;         // prev_ls the time of the first previous time the magnet was passed through. Time of the magnets in the crank wheel
unsigned long prev_shaft;         // prev_ls the time of the first previous time the magnet was passed through. Time of the magnets in the crank wheel
unsigned long prev_output;
float RPM_L;                     // RPM of the left wheel
float RPM_R;                    // RPM of the right wheel 
float RPM_C;                   // RPM of the centre wheel
float RPM_CRANK;              // RPM of the crank wheel
float RPM_SHAFT;              // RPM of the gear shaft
float total_speed;           // total speed if the bike 
int samples = 0; 
int x = 0; 

/////////////////////////////////////////////////STEERING ANGLE VARIABLES///////////////////////////////////////////////////
//////////////////////////////////////////////////////////////////////////////////////////////////////////////////////////

float steering_angle;
float steering_angle_max;
float steering_angle_min;
float steering_angle_center;

///////////////////////////////////////////////////AIR QUALITY//////////////////////////////////////////////////////////////////////////////////////////////////////////////////////////////////////////////////////
////////////////////////////////////////////////////////////////////////////////////////////////////////////////////////////////////////////////////////////////////////////////////////////////////////////////////

float seaLevel;              // SeaLevel value 
float Temperature;          // Temperature value 
float Humidity;            // Humidity value 
float Pressure;           // Pressure value
unsigned long lastRead=0;

////////////////////////////////////////////////////////PINS///////////////////////////////////////////////////////////////////////////////////////////////////////////////////////////////////////////////////////
///////////////////////////////////////////////////////////////////////////////////////////////////////////////////////////////////////////////////////////////////////////////////////////////////////////////////

const int hall_pin = 12;         // Pin relates to wheel left 
const int hall_pin2 = 13;        // Pin relates to wheel right 
const int hall_pin3 = 14;      // Pin relates to wheel centre 
const int hall_pin4 = 27;      // Pin relates to crank
const int hall_pin5 = 26;      // Pin relates to gear shaft

//////////////////////////////////////////////////// TWEAK variables///////////////////////////////////////////////////////////////////////////////////////////////////////////////////////////////////////////////
///////////////////////////////////////////////////////////////////////////////////////////////////////////////////////////////////////////////////////////////////////////////////////////////////////////////////

float wheel_circumference = 2.777; //Circumference of wheel 
const int Magnet_Number = 8; // Number of magnets on the tone wheel
const int print_frequency = 9; //milliseconds between serial.print

////////////////////////////////////////////INTERRUPT FUNCTIONS///////////////////////////////////////////////////////////////////////////////////////////////////////////////////////////////////////////////////////////
////////////////////////////////////////////////////////////////////////////////////////////////////////////////////////////////////////////////////////////////////////////////////////////////////////////////////////// 

////////////////////////////////////////TIMING BETWEEN EACH MAGNET////////////////////////////////////////////////////////////////////////////////////////////////////////////////////////////////////////////////////////
//////////////////////////////////////////////////////////////////////////////////////////////////////////////////////////////////////////////////////////////////////////////////////////////////////////////////////////

////////left wheel //////////////

void IRAM_ATTR wheel_left(){
  time_l = micros() - prev_l; 
  prev_l = micros(); 
}

////////right wheel ////////////

void IRAM_ATTR wheel_right(){
  time_r = micros() - prev_r;
  prev_r = micros();
}

///////////centre wheel//////////

void IRAM_ATTR wheel_centre(){
  time_c = micros() - prev_c;
  prev_c = micros();
}

/////////crank wheel////////////

void IRAM_ATTR crank(){
  time_cr = micros() - prev_cr; 
  prev_cr = micros();
}

/////////gear shaft////////////

void IRAM_ATTR gear_shaft(){
  time_shaft = micros() - prev_shaft; 
  prev_shaft = micros();
}


////////////////////////////////////////////////////SETUP//////////////////////////////////////////////////////////////////////////////////////////////////////////////////////////////////////////////////////////
///////////////////////////////////////////////////////////////////////////////////////////////////////////////////////////////////////////////////////////////////////////////////////////////////////////////////



void setup() {
  Serial.begin(115200);
  //Serial2.begin(115200, SERIAL_8N1, 16, 17);
  pinMode(hall_pin, INPUT);       //Pin initialization
  pinMode(hall_pin2, INPUT);      //Pin initialization
  pinMode(hall_pin3, INPUT);      //Pin initialization
  pinMode(hall_pin4, INPUT);      //Pin initialization
  pinMode(hall_pin5, INPUT);      //Pin initialization
  attachInterrupt(digitalPinToInterrupt(hall_pin), wheel_left, RISING); //Interrupt initialization
  attachInterrupt(digitalPinToInterrupt(hall_pin2), wheel_right, RISING); //Interrupt initialization
  attachInterrupt(digitalPinToInterrupt(hall_pin3), wheel_centre, RISING); //Interrupt initialization
  attachInterrupt(digitalPinToInterrupt(hall_pin4), crank, RISING); //Interrupt initialization
  attachInterrupt(digitalPinToInterrupt(hall_pin5), gear_shaft, RISING); //Interrupt initialization
  RPM_L_RA.clear();               // Clearing cache of the averaging for the left wheel 
  RPM_R_RA.clear();               // Clearing cache of the averaging for the right wheel
  RPM_C_RA.clear();               // Clearing cache of the averaging for the centre wheel
  RPM_CRANK_RA.clear();           // Clearing cache of the averaging for the crank wheel
  RPM_SHAFT_RA.clear();           // Clearing cache of the averaging for the crank wheel

///////////////////////////////////////////TEMPERATURE SETUP/////////////////////////////////////////////////////////////////////////////////////////////////////////////////////////////////////////////////////////////
///////////////////////////////////////////////////////////////////////////////////////////////////////////////////////////////////////////////////////////////////////////////////////////////////////////////////
 
  uint8_t rslt = 1;
  while(!Serial);
  rslt = bme.begin();
  Serial.println("BME WORKING");
  bme.startConvert();
  bme.update();

///////////////////////////////////////////magnetometer/////////////////////////////////////////////////////////////////////
////////////////////////////////////////////////////////////////////////////////////////////////////////////////////////////

//magnetometer
  mag.begin();
  mag.enableAutoRange(true);
  //accelerometer
  accel.begin();

 //////////////////////////////////////STEERING ANGLE SETUP/////////////////////////////////////////
 ////////////////////////////////////////////////////////////////////////////////////

 as5600.begin(4);

}

///////////////////////////////////////////MAIN////////////////////////////////////////////////////////////////////////////////////////////////////////////////////////////////////////////////////////////////////////////
///////////////////////////////////////////////////////////////////////////////////////////////////////////////////////////////////////////////////////////////////////////////////////////////////////////////////////////

void loop() {
  
  steering_angle=as5600.rawAngle()/11.37777; //////conversion to degrees
  if(steering_angle>180){
    steering_angle=-360+steering_angle;
  }         //////setting negative angles
  if(steering_angle>steering_angle_max){
    steering_angle_max=steering_angle;
  } ///capturing max value
  if(steering_angle<steering_angle_min){
    steering_angle_min=steering_angle;
  } ///capturing min value
  steering_angle_center=(steering_angle_max+steering_angle_min)/2; ////calculating center


  
  sensors_event_t event; //declare event

  accel.getEvent(&event); //capture accelerometer data
    
  
  RPM_L = (60000000.00/(time_l*Magnet_Number));          // RPM left
  RPM_R = (60000000.00/(time_r*Magnet_Number));         // RPM Right
  RPM_C = (60000000.00/(time_c*Magnet_Number));        // RPM Centre
  RPM_CRANK = (60000000.00/(time_cr*Magnet_Number));  //RPM Crank
  RPM_SHAFT = (60000000.00/(time_shaft*Magnet_Number));  //RPM Crank

  //Calculates the cadence of crank 
  //Cadence = (RPM_CRANK*wheel_circumference/16.6670)/(3.14*(diameter +(2 * tire_size)) * (chainring/cog))
  
  ////////////////////////////////////Calculates the total Speed////////////////////////////////////////////////////////////////////////////////////////////////////////// 
  
  total_speed = ((RPM_L + RPM_R + RPM_C)/3)*wheel_circumference/16.6670; 
  
  ///////////////////////////////////Adds value to running average/////////////////////////////////////////////////////////////////
  
  RPM_L_RA.addValue(RPM_L);             // Adds value to running average wheel left
  RPM_R_RA.addValue(RPM_R);            // Adds value to running average wheel right
  RPM_C_RA.addValue(RPM_C);           // Adds value to running average wheel centre
  RPM_CRANK_RA.addValue(RPM_CRANK);  // Adds value to runing average wheel crank
  RPM_SHAFT_RA.addValue(RPM_SHAFT); 

  ///////////////////////////////////Read AIR QUALITY sensor///////////////////////////////////////////////////////////////////////////////////////////////
  
    if(millis()-lastRead>1000){
      bme.startConvert();
      bme.update();
      Temperature=bme.readTemperature() / 100, 2;
      Humidity=bme.readHumidity() / 1000, 2;
      Pressure=bme.readPressure();
      lastRead=millis();
     }

       mag.getEvent(&event); //capture magnetometer data

    //CALCULATE HEADING from magnetometer data
    float heading = (atan2(event.magnetic.y,event.magnetic.x) * 180) / 3.14159;
     if (heading < 0)
     {
     heading = 360 + heading;
    }
  
  //////////////////////////////////////////////Print to screen///////////////////////////////////////////////////////////////////////////
  
  time_output = millis()-prev_output;
   if (time_output > print_frequency){
   prev_output = millis();
    if(RPM_L_RA.getAverage()<0 || RPM_L_RA.getAverage()>10000){
      Serial.print(0);
    } else {
      Serial.print(RPM_L_RA.getAverage(),2);     //Printing RPM value for Left wheel 
    }
    Serial.print(",");
    if(RPM_R_RA.getAverage()<0 || RPM_R_RA.getAverage()>10000){
      Serial.print(0);
    } else{
      Serial.print(RPM_R_RA.getAverage(),2);     //Printing RPM value for right wheel
    }
    Serial.print(",");
    if(RPM_C_RA.getAverage()<0 || RPM_C_RA.getAverage()>10000){
      Serial.print(0);
    } else {
      Serial.print(RPM_C_RA.getAverage(),2);    // Printing RPM value for centre wheel
    }
    Serial.print(",");
    if(RPM_CRANK_RA.getAverage()<=0 || RPM_CRANK_RA.getAverage()>20000){
      Serial.print(0);
    } else {
      Serial.print(RPM_CRANK_RA.getAverage(),2); // Printing RPM value for crank wheel
    }
    Serial.print(",");
    if(RPM_SHAFT_RA.getAverage()<0 || RPM_SHAFT_RA.getAverage()>10000){
      Serial.print(0);
    } else {
      Serial.print(RPM_SHAFT_RA.getAverage(),2);     //Printing RPM value for gear shaft 
    }
    Serial.print(",");
    if(total_speed<0 || total_speed>10000){
      Serial.print(0);
    } else {
      Serial.print(total_speed);  // Printing total speed
    }
    Serial.print(",");
    Serial.print(Temperature);  //Printing Temperature 
    Serial.print(",");
    Serial.print(Humidity);    // Printing Humidity 
    Serial.print(",");
    Serial.print(Pressure); // Printing Pressure
    //print accelerometer
    Serial.print(event.acceleration.x); 
    Serial.print(",");
    Serial.print(event.acceleration.y); 
    Serial.print(",");
    Serial.print(event.acceleration.z); 
    Serial.print(",");
    //print magnetometer
    Serial.print(event.magnetic.x);
    Serial.print(","); 
    Serial.print(event.magnetic.y); 
    Serial.print(",");
    Serial.print(event.magnetic.z);
    Serial.print(",");
    Serial.println(steering_angle-steering_angle_center); 
  }
}
